## conf/bblayers.conf
```bitbake
# LAYER_CONF_VERSION is increased each time build/conf/bblayers.conf
# changes incompatibly
LCONF_VERSION = "6"

BBPATH = "${TOPDIR}"
BBFILES ?= ""

BBLAYERS ?= " \
  ${TOPDIR}/../meta \
  ${TOPDIR}/../meta-yocto \
  ${TOPDIR}/../meta-yocto-bsp \
  ${TOPDIR}/../meta-openembedded/meta-oe \
  "

#BBLAYERS += " ${TOPDIR}/../meta-xilinx"
#BBLAYERS += " ${TOPDIR}/../meta-altera"
BBLAYERS += " ${TOPDIR}/../meta-qt5"
BBLAYERS += " ${TOPDIR}/../meta-aquaxis"

BBLAYERS_NON_REMOVABLE ?= " \
  ${TOPDIR}/../meta \
  ${TOPDIR}/../meta-yocto \
  "
```
